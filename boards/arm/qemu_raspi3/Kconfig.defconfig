## boards/arm/qemu_raspi3/Kconfig.defconfig
```kconfig
# Copyright (c) 2019 Carlo Caione <ccaione@baylibre.com>
# SPDX-License-Identifier: Apache-2.0

if BOARD_QEMU_RASPI3

config BUILD_OUTPUT_BIN
	default y

config BOARD
	default "qemu_raspi3"

endif # BOARD_QEMU_RASPI3
```

## boards/arm/raspi3/Kconfig.board
```kconfig
# Copyright (c) 2019 Carlo Caione <ccaione@baylibre.com>
# SPDX-License-Identifier: Apache-2.0

config BOARD_RASPI3
	bool "Raspberry Pi 3 Model B+ and QEMU Machine raspi3"
	depends on SOC_BCM2837
	select ARM64
	select QEMU_TARGET
```

## boards/arm/raspi3/Kconfig.defconfig
```kconfig
# Copyright (c) 2019 Carlo Caione <ccaione@baylibre.com>
# SPDX-License-Identifier: Apache-2.0

if BOARD_RASPI3

config BUILD_OUTPUT_BIN
	default y

config BOARD
	default "raspi3"

endif # BOARD_RASPI3
```

## boards/arm/raspi3/raspi3_defconfig
```kconfig
CONFIG_SOC_BCM2837=y
CONFIG_BOARD_RASPI3=y
CONFIG_XIP=n
CONFIG_QEMU_ICOUNT=n

# Enable UART driver
CONFIG_SERIAL=y

# Enable console
CONFIG_CONSOLE=y
CONFIG_UART_CONSOLE=y

# Enable serial port
CONFIG_UART_PL011=y
CONFIG_UART_PL011_PORT0=y
CONFIG_UART_INTERRUPT_DRIVEN=n

CONFIG_SMP=y
CONFIG_MP_NUM_CPUS=4
CONFIG_CACHE_MANAGEMENT=y
CONFIG_TIMEOUT_64BIT=y
CONFIG_ARMV8_A_NS=y

CONFIG_AARCH64_IMAGE_HEADER=y

# Memory offset to which the kerenl image is loaded by the bootloader.
# If this is wrong, references to static data in the kernel image are off.
# https://wiki.osdev.org/Raspberry_Pi_Bare_Bones#Pi_3.2C_4
CONFIG_SRAM_BASE_ADDRESS=0x200000
CONFIG_KERNEL_VM_BASE=0x200000

# In KiB.
CONFIG_SRAM_SIZE=256

CONFIG_LOG=y
CONFIG_LOG_MODE_MINIMAL=y

CONFIG_ARM_ARCH_TIMER=y

CONFIG_DEBUG=y
CONFIG_ASSERT=y
CONFIG_ASSERT_VERBOSE=y
CONFIG_STACK_SENTINEL=y
CONFIG_INIT_STACKS=y

CONFIG_TICKLESS_KERNEL=n
CONFIG_LOG_PRINTK=n
```

## boards/riscv/qemu_rv32_virt/qemu_rv32_virt_defconfig
```kconfig
# SPDX-License-Identifier: Apache-2.0

CONFIG_XIP=n
CONFIG_SOC_SERIES_QEMU_RV32_VIRT=y
CONFIG_SOC_QEMU_RV32_VIRT=y
CONFIG_BOARD_QEMU_RV32_VIRT=y
CONFIG_PLIC=y
CONFIG_CONSOLE=y
CONFIG_PRINTK=y
CONFIG_SERIAL=y
CONFIG_UART_NS16550=y
CONFIG_UART_NS16550_ACCESS_WORD_ONLY=n
CONFIG_UART_CONSOLE=y
CONFIG_RISCV_MACHINE_TIMER=y
CONFIG_SYS_CLOCK_HW_CYCLES_PER_SEC=10000000
CONFIG_QEMU_ICOUNT_SHIFT=6
CONFIG_SMP=y
CONFIG_MP_NUM_CPUS=4
CONFIG_LOG_PROCESS_THREAD_STACK_SIZE=3072
```

## dts/bindings/interrupt-controller/brcm,bcm2835-armctrl-ic.yaml
```yaml
# Copyright (c) 2018 Marvell
# SPDX-License-Identifier: Apache-2.0

description: Interrupt Controller

compatible: "brcm,bcm2835-armctrl-ic"

include: base.yaml

properties:
    reg:
      required: true

    label:
      required: true

# GIC-compatible to allow reuse of arm,arm-timer. flags and priority are always 0.
interrupt-cells:
  - irq
  - flags
  - priority
```

## dts/bindings/serial/arm,raspi3.yaml
```yaml
description: raspi3 UART

compatible: "arm,raspi3"

include: uart-controller.yaml

properties:
    reg:
      required: true
```

## soc/arm/bcm2837/Kconfig.soc
```kconfig
# Copyright (c) 2019 Carlo Caione <ccaione@baylibre.com>
# SPDX-License-Identifier: Apache-2.0

config SOC_BCM2837
	bool "BCM2837 and BCM2837B0 SoC, QEMU virt platform (raspi3)"
	select ARM
	select CPU_CORTEX_A53
```

## soc/arm/qemu_raspi3/Kconfig.soc
```kconfig
# Copyright (c) 2019 Carlo Caione <ccaione@baylibre.com>
# SPDX-License-Identifier: Apache-2.0

config SOC_QEMU_RASPI3
	bool "QEMU virt platform (raspi3)"
	select ARM
	select CPU_CORTEX_A53
	select GIC_V3
```
